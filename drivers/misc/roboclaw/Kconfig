## drivers/misc/roboclaw/Kconfig
```kconfig
# Copyright (c) 2023 LECRIVAIN Mathis <lecrivain.mathis@gmail.com>
# SPDX-License-Identifier: Apache-2.0

config ROBOCLAW_SERIAL
	bool "Roboclaw control over serial line device"
	default n
	depends on SERIAL && SERIAL_HAS_DRIVER
	depends on DT_HAS_BASICMICRO_ROBOCLAW_SERIAL_ENABLED
	help
	  Enable Roboclaw control over serial line support.
	  
if ROBOCLAW_SERIAL
    module = ROBOCLAW_SERIAL
    module-str = roboclaw
    source "subsys/logging/Kconfig.template.log_config"
endif
```

## dts/bindings/misc/basicmicro,roboclaw-serial.yaml
```yaml
# Copyright (c) 2020 PHYTEC Messtechnik GmbH
# SPDX-License-Identifier: Apache-2.0

description: Roboclaw control over serial line device

compatible: "basicmicro,roboclaw-serial"

include: uart-device.yaml

properties:
  address:
    type: int
    default: 0x80
    description: Roboclaw driver address
  timeout:
    type: int
    default: 100
    description: Roboclaw driver timeout in ms
```
